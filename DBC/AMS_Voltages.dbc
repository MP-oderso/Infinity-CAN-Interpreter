VERSION ""

NS_ :

BS_:

BU_: Third_Party VCU

BO_ 2667577600 Cart_state: 8 Vector__XXX
 SG_ Cart_voltage : 16|16@1- (1,0) [0|0] "" Vector__XXX
 SG_ Cart_Current : 0|16@1- (1,0) [0|0] "" Vector__XXX

BO_ 0 VCU_prog: 1 Third_Party
 SG_ NewSignal : 0|1@1+ (1,0) [0|1] ""  VCU

BO_ 2415919344 Current: 4 Third_Party
 SG_ Current : 0|32@1- (0.001,0) [-2147483.648|2147483.647] "A" Vector__XXX

BO_ 2415919359 Charging: 1 Third_Party
 SG_ NewSignal : 0|8@1+ (1,0) [0|255] "" Vector__XXX

BO_ 2667577360 AMS_Voltage_Cell_012: 7 Third_Party
 SG_ Stack0_V0 m0 : 8|16@1+ (0.0001,0) [0|6.5535] "V" Vector__XXX
 SG_ Stack0_V1 m0 : 24|16@1+ (0.0001,0) [0|6.5535] "V" Vector__XXX
 SG_ Stack0_V2 m0 : 40|16@1+ (0.0001,0) [0|6.5535] "V" Vector__XXX
 SG_ Stack1_V0 m1 : 8|16@1+ (0.0001,0) [0|6.5535] "V" Vector__XXX
 SG_ Stack1_V1 m1 : 24|16@1+ (0.0001,0) [0|6.5535] "V" Vector__XXX
 SG_ Stack1_V2 m1 : 40|16@1+ (0.0001,0) [0|6.5535] "V" Vector__XXX
 SG_ Stack2_V0 m2 : 8|16@1+ (0.0001,0) [0|6.5535] "V" Vector__XXX
 SG_ Stack2_V1 m2 : 24|16@1+ (0.0001,0) [0|6.5535] "V" Vector__XXX
 SG_ Stack2_V2 m2 : 40|16@1+ (0.0001,0) [0|6.5535] "V" Vector__XXX
 SG_ Stack3_V0 m3 : 8|16@1+ (0.0001,0) [0|6.5535] "V" Vector__XXX
 SG_ Stack3_V1 m3 : 24|16@1+ (0.0001,0) [0|6.5535] "V" Vector__XXX
 SG_ Stack3_V2 m3 : 40|16@1+ (0.0001,0) [0|6.5535] "V" Vector__XXX
 SG_ Stack4_V0 m4 : 8|16@1+ (0.0001,0) [0|6.5535] "V" Vector__XXX
 SG_ Stack4_V1 m4 : 24|16@1+ (0.0001,0) [0|6.5535] "V" Vector__XXX
 SG_ Stack4_V2 m4 : 40|16@1+ (0.0001,0) [0|6.5535] "V" Vector__XXX
 SG_ Stack5_V0 m5 : 8|16@1+ (0.0001,0) [0|6.5535] "V" Vector__XXX
 SG_ Stack5_V1 m5 : 24|16@1+ (0.0001,0) [0|6.5535] "V" Vector__XXX
 SG_ Stack5_V2 m5 : 40|16@1+ (0.0001,0) [0|6.5535] "V" Vector__XXX
 SG_ Stack6_V0 m6 : 8|16@1+ (0.0001,0) [0|6.5535] "V" Vector__XXX
 SG_ Stack6_V1 m6 : 24|16@1+ (0.0001,0) [0|6.5535] "V" Vector__XXX
 SG_ Stack6_V2 m6 : 40|16@1+ (0.0001,0) [0|6.5535] "V" Vector__XXX
 SG_ Stack7_V0 m7 : 8|16@1+ (0.0001,0) [0|6.5535] "V" Vector__XXX
 SG_ Stack7_V1 m7 : 24|16@1+ (0.0001,0) [0|6.5535] "V" Vector__XXX
 SG_ Stack7_V2 m7 : 40|16@1+ (0.0001,0) [0|6.5535] "V" Vector__XXX
 SG_ StackID M : 0|8@1+ (1,0) [0|255] "" Vector__XXX

BO_ 2667577361 AMS_Voltage_Cell_345: 7 Third_Party
 SG_ Stack0_V3 m0 : 8|16@1+ (0.0001,0) [0|6.5535] "V" Vector__XXX
 SG_ Stack0_V4 m0 : 24|16@1+ (0.0001,0) [0|6.5535] "V" Vector__XXX
 SG_ Stack0_V5 m0 : 40|16@1+ (0.0001,0) [0|6.5535] "V" Vector__XXX
 SG_ Stack1_V3 m1 : 8|16@1+ (0.0001,0) [0|6.5535] "V" Vector__XXX
 SG_ Stack1_V4 m1 : 24|16@1+ (0.0001,0) [0|6.5535] "V" Vector__XXX
 SG_ Stack1_V5 m1 : 40|16@1+ (0.0001,0) [0|6.5535] "V" Vector__XXX
 SG_ Stack2_V3 m2 : 8|16@1+ (0.0001,0) [0|6.5535] "V" Vector__XXX
 SG_ Stack2_V4 m2 : 24|16@1+ (0.0001,0) [0|6.5535] "V" Vector__XXX
 SG_ Stack2_V5 m2 : 40|16@1+ (0.0001,0) [0|6.5535] "V" Vector__XXX
 SG_ Stack3_V3 m3 : 8|16@1+ (0.0001,0) [0|6.5535] "V" Vector__XXX
 SG_ Stack3_V4 m3 : 24|16@1+ (0.0001,0) [0|6.5535] "V" Vector__XXX
 SG_ Stack3_V5 m3 : 40|16@1+ (0.0001,0) [0|6.5535] "V" Vector__XXX
 SG_ Stack4_V3 m4 : 8|16@1+ (0.0001,0) [0|6.5535] "V" Vector__XXX
 SG_ Stack4_V4 m4 : 24|16@1+ (0.0001,0) [0|6.5535] "V" Vector__XXX
 SG_ Stack4_V5 m4 : 40|16@1+ (0.0001,0) [0|6.5535] "V" Vector__XXX
 SG_ Stack5_V3 m5 : 8|16@1+ (0.0001,0) [0|6.5535] "V" Vector__XXX
 SG_ Stack5_V4 m5 : 24|16@1+ (0.0001,0) [0|6.5535] "V" Vector__XXX
 SG_ Stack5_V5 m5 : 40|16@1+ (0.0001,0) [0|6.5535] "V" Vector__XXX
 SG_ Stack6_V3 m6 : 8|16@1+ (0.0001,0) [0|6.5535] "V" Vector__XXX
 SG_ Stack6_V4 m6 : 24|16@1+ (0.0001,0) [0|6.5535] "V" Vector__XXX
 SG_ Stack6_V5 m6 : 40|16@1+ (0.0001,0) [0|6.5535] "V" Vector__XXX
 SG_ Stack7_V3 m7 : 8|16@1+ (0.0001,0) [0|6.5535] "V" Vector__XXX
 SG_ Stack7_V4 m7 : 24|16@1+ (0.0001,0) [0|6.5535] "V" Vector__XXX
 SG_ Stack7_V5 m7 : 40|16@1+ (0.0001,0) [0|6.5535] "V" Vector__XXX
 SG_ StackID M : 0|8@1+ (1,0) [0|255] "" Vector__XXX

BO_ 2667577362 AMS_Voltage_Cell_678: 7 Third_Party
 SG_ Stack0_V6 m0 : 8|16@1+ (0.0001,0) [0|6.5535] "V" Vector__XXX
 SG_ Stack0_V7 m0 : 24|16@1+ (0.0001,0) [0|6.5535] "V" Vector__XXX
 SG_ Stack0_V8 m0 : 40|16@1+ (0.0001,0) [0|6.5535] "V" Vector__XXX
 SG_ Stack1_V6 m1 : 8|16@1+ (0.0001,0) [0|6.5535] "V" Vector__XXX
 SG_ Stack1_V7 m1 : 24|16@1+ (0.0001,0) [0|6.5535] "V" Vector__XXX
 SG_ Stack1_V8 m1 : 40|16@1+ (0.0001,0) [0|6.5535] "V" Vector__XXX
 SG_ Stack2_V6 m2 : 8|16@1+ (0.0001,0) [0|6.5535] "V" Vector__XXX
 SG_ Stack2_V7 m2 : 24|16@1+ (0.0001,0) [0|6.5535] "V" Vector__XXX
 SG_ Stack2_V8 m2 : 40|16@1+ (0.0001,0) [0|6.5535] "V" Vector__XXX
 SG_ Stack3_V6 m3 : 8|16@1+ (0.0001,0) [0|6.5535] "V" Vector__XXX
 SG_ Stack3_V7 m3 : 24|16@1+ (0.0001,0) [0|6.5535] "V" Vector__XXX
 SG_ Stack3_V8 m3 : 40|16@1+ (0.0001,0) [0|6.5535] "V" Vector__XXX
 SG_ Stack4_V6 m4 : 8|16@1+ (0.0001,0) [0|6.5535] "V" Vector__XXX
 SG_ Stack4_V7 m4 : 24|16@1+ (0.0001,0) [0|6.5535] "V" Vector__XXX
 SG_ Stack4_V8 m4 : 40|16@1+ (0.0001,0) [0|6.5535] "V" Vector__XXX
 SG_ Stack5_V6 m5 : 8|16@1+ (0.0001,0) [0|6.5535] "V" Vector__XXX
 SG_ Stack5_V7 m5 : 24|16@1+ (0.0001,0) [0|6.5535] "V" Vector__XXX
 SG_ Stack5_V8 m5 : 40|16@1+ (0.0001,0) [0|6.5535] "V" Vector__XXX
 SG_ Stack6_V6 m6 : 8|16@1+ (0.0001,0) [0|6.5535] "V" Vector__XXX
 SG_ Stack6_V7 m6 : 24|16@1+ (0.0001,0) [0|6.5535] "V" Vector__XXX
 SG_ Stack6_V8 m6 : 40|16@1+ (0.0001,0) [0|6.5535] "V" Vector__XXX
 SG_ Stack7_V6 m7 : 8|16@1+ (0.0001,0) [0|6.5535] "V" Vector__XXX
 SG_ Stack7_V7 m7 : 24|16@1+ (0.0001,0) [0|6.5535] "V" Vector__XXX
 SG_ Stack7_V8 m7 : 40|16@1+ (0.0001,0) [0|6.5535] "V" Vector__XXX
 SG_ StackID M : 0|8@1+ (1,0) [0|255] "" Vector__XXX

BO_ 2667577363 AMS_Voltage_Cell_9AB: 7 Third_Party
 SG_ Stack0_V9 m0 : 8|16@1+ (0.0001,0) [0|6.5535] "V" Vector__XXX
 SG_ Stack0_VA m0 : 24|16@1+ (0.0001,0) [0|6.5535] "V" Vector__XXX
 SG_ Stack0_VB m0 : 40|16@1+ (0.0001,0) [0|6.5535] "V" Vector__XXX
 SG_ Stack1_V9 m1 : 8|16@1+ (0.0001,0) [0|6.5535] "V" Vector__XXX
 SG_ Stack1_VA m1 : 24|16@1+ (0.0001,0) [0|6.5535] "V" Vector__XXX
 SG_ Stack1_VB m1 : 40|16@1+ (0.0001,0) [0|6.5535] "V" Vector__XXX
 SG_ Stack2_V9 m2 : 8|16@1+ (0.0001,0) [0|6.5535] "V" Vector__XXX
 SG_ Stack2_VA m2 : 24|16@1+ (0.0001,0) [0|6.5535] "V" Vector__XXX
 SG_ Stack2_VB m2 : 40|16@1+ (0.0001,0) [0|6.5535] "V" Vector__XXX
 SG_ Stack3_V9 m3 : 8|16@1+ (0.0001,0) [0|6.5535] "V" Vector__XXX
 SG_ Stack3_VA m3 : 24|16@1+ (0.0001,0) [0|6.5535] "V" Vector__XXX
 SG_ Stack3_VB m3 : 40|16@1+ (0.0001,0) [0|6.5535] "V" Vector__XXX
 SG_ Stack4_V9 m4 : 8|16@1+ (0.0001,0) [0|6.5535] "V" Vector__XXX
 SG_ Stack4_VA m4 : 24|16@1+ (0.0001,0) [0|6.5535] "V" Vector__XXX
 SG_ Stack4_VB m4 : 40|16@1+ (0.0001,0) [0|6.5535] "V" Vector__XXX
 SG_ Stack5_V9 m5 : 8|16@1+ (0.0001,0) [0|6.5535] "V" Vector__XXX
 SG_ Stack5_VA m5 : 24|16@1+ (0.0001,0) [0|6.5535] "V" Vector__XXX
 SG_ Stack5_VB m5 : 40|16@1+ (0.0001,0) [0|6.5535] "V" Vector__XXX
 SG_ Stack6_V9 m6 : 8|16@1+ (0.0001,0) [0|6.5535] "V" Vector__XXX
 SG_ Stack6_VA m6 : 24|16@1+ (0.0001,0) [0|6.5535] "V" Vector__XXX
 SG_ Stack6_VB m6 : 40|16@1+ (0.0001,0) [0|6.5535] "V" Vector__XXX
 SG_ Stack7_V9 m7 : 8|16@1+ (0.0001,0) [0|6.5535] "V" Vector__XXX
 SG_ Stack7_VA m7 : 24|16@1+ (0.0001,0) [0|6.5535] "V" Vector__XXX
 SG_ Stack7_VB m7 : 40|16@1+ (0.0001,0) [0|6.5535] "V" Vector__XXX
 SG_ StackID M : 0|8@1+ (1,0) [0|255] "" Vector__XXX

BO_ 2667577364 AMS_Voltage_Cell_CDE: 7 Third_Party
 SG_ Stack0_VC m0 : 8|16@1+ (0.0001,0) [0|6.5535] "V" Vector__XXX
 SG_ Stack0_VD m0 : 24|16@1+ (0.0001,0) [0|6.5535] "V" Vector__XXX
 SG_ Stack0_VE m0 : 40|16@1+ (0.0001,0) [0|6.5535] "V" Vector__XXX
 SG_ Stack1_VC m1 : 8|16@1+ (0.0001,0) [0|6.5535] "V" Vector__XXX
 SG_ Stack1_VD m1 : 24|16@1+ (0.0001,0) [0|6.5535] "V" Vector__XXX
 SG_ Stack1_VE m1 : 40|16@1+ (0.0001,0) [0|6.5535] "V" Vector__XXX
 SG_ Stack2_VC m2 : 8|16@1+ (0.0001,0) [0|6.5535] "V" Vector__XXX
 SG_ Stack2_VD m2 : 24|16@1+ (0.0001,0) [0|6.5535] "V" Vector__XXX
 SG_ Stack2_VE m2 : 40|16@1+ (0.0001,0) [0|6.5535] "V" Vector__XXX
 SG_ Stack3_VC m3 : 8|16@1+ (0.0001,0) [0|6.5535] "V" Vector__XXX
 SG_ Stack3_VD m3 : 24|16@1+ (0.0001,0) [0|6.5535] "V" Vector__XXX
 SG_ Stack3_VE m3 : 40|16@1+ (0.0001,0) [0|6.5535] "V" Vector__XXX
 SG_ Stack4_VC m4 : 8|16@1+ (0.0001,0) [0|6.5535] "V" Vector__XXX
 SG_ Stack4_VD m4 : 24|16@1+ (0.0001,0) [0|6.5535] "V" Vector__XXX
 SG_ Stack4_VE m4 : 40|16@1+ (0.0001,0) [0|6.5535] "V" Vector__XXX
 SG_ Stack5_VC m5 : 8|16@1+ (0.0001,0) [0|6.5535] "V" Vector__XXX
 SG_ Stack5_VD m5 : 24|16@1+ (0.0001,0) [0|6.5535] "V" Vector__XXX
 SG_ Stack5_VE m5 : 40|16@1+ (0.0001,0) [0|6.5535] "V" Vector__XXX
 SG_ Stack6_VC m6 : 8|16@1+ (0.0001,0) [0|6.5535] "V" Vector__XXX
 SG_ Stack6_VD m6 : 24|16@1+ (0.0001,0) [0|6.5535] "V" Vector__XXX
 SG_ Stack6_VE m6 : 40|16@1+ (0.0001,0) [0|6.5535] "V" Vector__XXX
 SG_ Stack7_VC m7 : 8|16@1+ (0.0001,0) [0|6.5535] "V" Vector__XXX
 SG_ Stack7_VD m7 : 24|16@1+ (0.0001,0) [0|6.5535] "V" Vector__XXX
 SG_ Stack7_VE m7 : 40|16@1+ (0.0001,0) [0|6.5535] "V" Vector__XXX
 SG_ StackID M : 0|8@1+ (1,0) [0|255] "" Vector__XXX

BO_ 2667577365 AMS_Voltage_Cell_FGH: 7 Third_Party
 SG_ Stack0_VF m0 : 8|16@1+ (0.0001,0) [0|6.5535] "V" Vector__XXX
 SG_ Stack0_VG m0 : 24|16@1+ (0.0001,0) [0|6.5535] "V" Vector__XXX
 SG_ Stack0_VH m0 : 40|16@1+ (0.0001,0) [0|6.5535] "V" Vector__XXX
 SG_ Stack1_VF m1 : 8|16@1+ (0.0001,0) [0|6.5535] "V" Vector__XXX
 SG_ Stack1_VG m1 : 24|16@1+ (0.0001,0) [0|6.5535] "V" Vector__XXX
 SG_ Stack1_VH m1 : 40|16@1+ (0.0001,0) [0|6.5535] "V" Vector__XXX
 SG_ Stack2_VF m2 : 8|16@1+ (0.0001,0) [0|6.5535] "V" Vector__XXX
 SG_ Stack2_VG m2 : 24|16@1+ (0.0001,0) [0|6.5535] "V" Vector__XXX
 SG_ Stack2_VH m2 : 40|16@1+ (0.0001,0) [0|6.5535] "V" Vector__XXX
 SG_ Stack3_VF m3 : 8|16@1+ (0.0001,0) [0|6.5535] "V" Vector__XXX
 SG_ Stack3_VG m3 : 24|16@1+ (0.0001,0) [0|6.5535] "V" Vector__XXX
 SG_ Stack3_VH m3 : 40|16@1+ (0.0001,0) [0|6.5535] "V" Vector__XXX
 SG_ Stack4_VF m4 : 8|16@1+ (0.0001,0) [0|6.5535] "V" Vector__XXX
 SG_ Stack4_VG m4 : 24|16@1+ (0.0001,0) [0|6.5535] "V" Vector__XXX
 SG_ Stack4_VH m4 : 40|16@1+ (0.0001,0) [0|6.5535] "V" Vector__XXX
 SG_ Stack5_VF m5 : 8|16@1+ (0.0001,0) [0|6.5535] "V" Vector__XXX
 SG_ Stack5_VG m5 : 24|16@1+ (0.0001,0) [0|6.5535] "V" Vector__XXX
 SG_ Stack5_VH m5 : 40|16@1+ (0.0001,0) [0|6.5535] "V" Vector__XXX
 SG_ Stack6_VF m6 : 8|16@1+ (0.0001,0) [0|6.5535] "V" Vector__XXX
 SG_ Stack6_VG m6 : 24|16@1+ (0.0001,0) [0|6.5535] "V" Vector__XXX
 SG_ Stack6_VH m6 : 40|16@1+ (0.0001,0) [0|6.5535] "V" Vector__XXX
 SG_ Stack7_VF m7 : 8|16@1+ (0.0001,0) [0|6.5535] "V" Vector__XXX
 SG_ Stack7_VG m7 : 24|16@1+ (0.0001,0) [0|6.5535] "V" Vector__XXX
 SG_ Stack7_VH m7 : 40|16@1+ (0.0001,0) [0|6.5535] "V" Vector__XXX
 SG_ StackID M : 0|8@1+ (1,0) [0|255] "" Vector__XXX

BO_ 2667577376 AMS_Temperature_0: 7 Third_Party
 SG_ Stack0_T00 m0 : 8|16@1- (0.0625,0) [-2048|2047.9375] "°C" Vector__XXX
 SG_ Stack0_T01 m0 : 24|16@1- (0.0625,0) [-2048|2047.9375] "°C" Vector__XXX
 SG_ Stack0_T02 m0 : 40|16@1- (0.0625,0) [-2048|2047.9375] "°C" Vector__XXX
 SG_ Stack1_T00 m1 : 8|16@1- (0.0625,0) [-2048|2047.9375] "°C" Vector__XXX
 SG_ Stack1_T01 m1 : 24|16@1- (0.0625,0) [-2048|2047.9375] "°C" Vector__XXX
 SG_ Stack1_T02 m1 : 40|16@1- (0.0625,0) [-2048|2047.9375] "°C" Vector__XXX
 SG_ Stack2_T00 m2 : 8|16@1- (0.0625,0) [-2048|2047.9375] "°C" Vector__XXX
 SG_ Stack2_T01 m2 : 24|16@1- (0.0625,0) [-2048|2047.9375] "°C" Vector__XXX
 SG_ Stack2_T02 m2 : 40|16@1- (0.0625,0) [-2048|2047.9375] "°C" Vector__XXX
 SG_ Stack3_T00 m3 : 8|16@1- (0.0625,0) [-2048|2047.9375] "°C" Vector__XXX
 SG_ Stack3_T01 m3 : 24|16@1- (0.0625,0) [-2048|2047.9375] "°C" Vector__XXX
 SG_ Stack3_T02 m3 : 40|16@1- (0.0625,0) [-2048|2047.9375] "°C" Vector__XXX
 SG_ Stack4_T00 m4 : 8|16@1- (0.0625,0) [-2048|2047.9375] "°C" Vector__XXX
 SG_ Stack4_T01 m4 : 24|16@1- (0.0625,0) [-2048|2047.9375] "°C" Vector__XXX
 SG_ Stack4_T02 m4 : 40|16@1- (0.0625,0) [-2048|2047.9375] "°C" Vector__XXX
 SG_ Stack5_T00 m5 : 8|16@1- (0.0625,0) [-2048|2047.9375] "°C" Vector__XXX
 SG_ Stack5_T01 m5 : 24|16@1- (0.0625,0) [-2048|2047.9375] "°C" Vector__XXX
 SG_ Stack5_T02 m5 : 40|16@1- (0.0625,0) [-2048|2047.9375] "°C" Vector__XXX
 SG_ Stack6_T00 m6 : 8|16@1- (0.0625,0) [-2048|2047.9375] "°C" Vector__XXX
 SG_ Stack6_T01 m6 : 24|16@1- (0.0625,0) [-2048|2047.9375] "°C" Vector__XXX
 SG_ Stack6_T02 m6 : 40|16@1- (0.0625,0) [-2048|2047.9375] "°C" Vector__XXX
 SG_ Stack7_T00 m7 : 8|16@1- (0.0625,0) [-2048|2047.9375] "°C" Vector__XXX
 SG_ Stack7_T01 m7 : 24|16@1- (0.0625,0) [-2048|2047.9375] "°C" Vector__XXX
 SG_ Stack7_T02 m7 : 40|16@1- (0.0625,0) [-2048|2047.9375] "°C" Vector__XXX
 SG_ StackID M : 0|8@1+ (1,0) [0|255] "" Vector__XXX

BO_ 2667577377 AMS_Temperature_1: 7 Third_Party
 SG_ Stack0_T03 m0 : 8|16@1- (0.0625,0) [-2048|2047.9375] "°C" Vector__XXX
 SG_ Stack0_T04 m0 : 24|16@1- (0.0625,0) [-2048|2047.9375] "°C" Vector__XXX
 SG_ Stack0_T05 m0 : 40|16@1- (0.0625,0) [-2048|2047.9375] "°C" Vector__XXX
 SG_ Stack1_T03 m1 : 8|16@1- (0.0625,0) [-2048|2047.9375] "°C" Vector__XXX
 SG_ Stack1_T04 m1 : 24|16@1- (0.0625,0) [-2048|2047.9375] "°C" Vector__XXX
 SG_ Stack1_T05 m1 : 40|16@1- (0.0625,0) [-2048|2047.9375] "°C" Vector__XXX
 SG_ Stack2_T03 m2 : 8|16@1- (0.0625,0) [-2048|2047.9375] "°C" Vector__XXX
 SG_ Stack2_T04 m2 : 24|16@1- (0.0625,0) [-2048|2047.9375] "°C" Vector__XXX
 SG_ Stack2_T05 m2 : 40|16@1- (0.0625,0) [-2048|2047.9375] "°C" Vector__XXX
 SG_ Stack3_T03 m3 : 8|16@1- (0.0625,0) [-2048|2047.9375] "°C" Vector__XXX
 SG_ Stack3_T04 m3 : 24|16@1- (0.0625,0) [-2048|2047.9375] "°C" Vector__XXX
 SG_ Stack3_T05 m3 : 40|16@1- (0.0625,0) [-2048|2047.9375] "°C" Vector__XXX
 SG_ Stack4_T03 m4 : 8|16@1- (0.0625,0) [-2048|2047.9375] "°C" Vector__XXX
 SG_ Stack4_T04 m4 : 24|16@1- (0.0625,0) [-2048|2047.9375] "°C" Vector__XXX
 SG_ Stack4_T05 m4 : 40|16@1- (0.0625,0) [-2048|2047.9375] "°C" Vector__XXX
 SG_ Stack5_T03 m5 : 8|16@1- (0.0625,0) [-2048|2047.9375] "°C" Vector__XXX
 SG_ Stack5_T04 m5 : 24|16@1- (0.0625,0) [-2048|2047.9375] "°C" Vector__XXX
 SG_ Stack5_T05 m5 : 40|16@1- (0.0625,0) [-2048|2047.9375] "°C" Vector__XXX
 SG_ Stack6_T03 m6 : 8|16@1- (0.0625,0) [-2048|2047.9375] "°C" Vector__XXX
 SG_ Stack6_T04 m6 : 24|16@1- (0.0625,0) [-2048|2047.9375] "°C" Vector__XXX
 SG_ Stack6_T05 m6 : 40|16@1- (0.0625,0) [-2048|2047.9375] "°C" Vector__XXX
 SG_ Stack7_T03 m7 : 8|16@1- (0.0625,0) [-2048|2047.9375] "°C" Vector__XXX
 SG_ Stack7_T04 m7 : 24|16@1- (0.0625,0) [-2048|2047.9375] "°C" Vector__XXX
 SG_ Stack7_T05 m7 : 40|16@1- (0.0625,0) [-2048|2047.9375] "°C" Vector__XXX
 SG_ StackID M : 0|8@1+ (1,0) [0|255] "" Vector__XXX

BO_ 2667577378 AMS_Temperature_3: 7 Third_Party
 SG_ Stack0_T06 m0 : 8|16@1- (0.0625,0) [-2048|2047.9375] "°C" Vector__XXX
 SG_ Stack0_T07 m0 : 24|16@1- (0.0625,0) [-2048|2047.9375] "°C" Vector__XXX
 SG_ Stack0_T08 m0 : 40|16@1- (0.0625,0) [-2048|2047.9375] "°C" Vector__XXX
 SG_ Stack1_T06 m1 : 8|16@1- (0.0625,0) [-2048|2047.9375] "°C" Vector__XXX
 SG_ Stack1_T07 m1 : 24|16@1- (0.0625,0) [-2048|2047.9375] "°C" Vector__XXX
 SG_ Stack1_T08 m1 : 40|16@1- (0.0625,0) [-2048|2047.9375] "°C" Vector__XXX
 SG_ Stack2_T06 m2 : 8|16@1- (0.0625,0) [-2048|2047.9375] "°C" Vector__XXX
 SG_ Stack2_T07 m2 : 24|16@1- (0.0625,0) [-2048|2047.9375] "°C" Vector__XXX
 SG_ Stack2_T08 m2 : 40|16@1- (0.0625,0) [-2048|2047.9375] "°C" Vector__XXX
 SG_ Stack3_T06 m3 : 8|16@1- (0.0625,0) [-2048|2047.9375] "°C" Vector__XXX
 SG_ Stack3_T07 m3 : 24|16@1- (0.0625,0) [-2048|2047.9375] "°C" Vector__XXX
 SG_ Stack3_T08 m3 : 40|16@1- (0.0625,0) [-2048|2047.9375] "°C" Vector__XXX
 SG_ Stack4_T06 m4 : 8|16@1- (0.0625,0) [-2048|2047.9375] "°C" Vector__XXX
 SG_ Stack4_T07 m4 : 24|16@1- (0.0625,0) [-2048|2047.9375] "°C" Vector__XXX
 SG_ Stack4_T08 m4 : 40|16@1- (0.0625,0) [-2048|2047.9375] "°C" Vector__XXX
 SG_ Stack5_T06 m5 : 8|16@1- (0.0625,0) [-2048|2047.9375] "°C" Vector__XXX
 SG_ Stack5_T07 m5 : 24|16@1- (0.0625,0) [-2048|2047.9375] "°C" Vector__XXX
 SG_ Stack5_T08 m5 : 40|16@1- (0.0625,0) [-2048|2047.9375] "°C" Vector__XXX
 SG_ Stack6_T06 m6 : 8|16@1- (0.0625,0) [-2048|2047.9375] "°C" Vector__XXX
 SG_ Stack6_T07 m6 : 24|16@1- (0.0625,0) [-2048|2047.9375] "°C" Vector__XXX
 SG_ Stack6_T08 m6 : 40|16@1- (0.0625,0) [-2048|2047.9375] "°C" Vector__XXX
 SG_ Stack7_T06 m7 : 8|16@1- (0.0625,0) [-2048|2047.9375] "°C" Vector__XXX
 SG_ Stack7_T07 m7 : 24|16@1- (0.0625,0) [-2048|2047.9375] "°C" Vector__XXX
 SG_ Stack7_T08 m7 : 40|16@1- (0.0625,0) [-2048|2047.9375] "°C" Vector__XXX
 SG_ StackID M : 0|8@1+ (1,0) [0|255] "" Vector__XXX

BO_ 2667577379 AMS_Temperature_2: 7 Third_Party
 SG_ Stack0_T09 m0 : 8|16@1- (0.0625,0) [-2048|2047.9375] "°C" Vector__XXX
 SG_ Stack0_T10 m0 : 24|16@1- (0.0625,0) [-2048|2047.9375] "°C" Vector__XXX
 SG_ Stack0_T11 m0 : 40|16@1- (0.0625,0) [-2048|2047.9375] "°C" Vector__XXX
 SG_ Stack1_T09 m1 : 8|16@1- (0.0625,0) [-2048|2047.9375] "°C" Vector__XXX
 SG_ Stack1_T10 m1 : 24|16@1- (0.0625,0) [-2048|2047.9375] "°C" Vector__XXX
 SG_ Stack1_T11 m1 : 40|16@1- (0.0625,0) [-2048|2047.9375] "°C" Vector__XXX
 SG_ Stack2_T09 m2 : 8|16@1- (0.0625,0) [-2048|2047.9375] "°C" Vector__XXX
 SG_ Stack2_T10 m2 : 24|16@1- (0.0625,0) [-2048|2047.9375] "°C" Vector__XXX
 SG_ Stack2_T11 m2 : 40|16@1- (0.0625,0) [-2048|2047.9375] "°C" Vector__XXX
 SG_ Stack3_T09 m3 : 8|16@1- (0.0625,0) [-2048|2047.9375] "°C" Vector__XXX
 SG_ Stack3_T10 m3 : 24|16@1- (0.0625,0) [-2048|2047.9375] "°C" Vector__XXX
 SG_ Stack3_T11 m3 : 40|16@1- (0.0625,0) [-2048|2047.9375] "°C" Vector__XXX
 SG_ Stack4_T09 m4 : 8|16@1- (0.0625,0) [-2048|2047.9375] "°C" Vector__XXX
 SG_ Stack4_T10 m4 : 24|16@1- (0.0625,0) [-2048|2047.9375] "°C" Vector__XXX
 SG_ Stack4_T11 m4 : 40|16@1- (0.0625,0) [-2048|2047.9375] "°C" Vector__XXX
 SG_ Stack5_T09 m5 : 8|16@1- (0.0625,0) [-2048|2047.9375] "°C" Vector__XXX
 SG_ Stack5_T10 m5 : 24|16@1- (0.0625,0) [-2048|2047.9375] "°C" Vector__XXX
 SG_ Stack5_T11 m5 : 40|16@1- (0.0625,0) [-2048|2047.9375] "°C" Vector__XXX
 SG_ Stack6_T09 m6 : 8|16@1- (0.0625,0) [-2048|2047.9375] "°C" Vector__XXX
 SG_ Stack6_T10 m6 : 24|16@1- (0.0625,0) [-2048|2047.9375] "°C" Vector__XXX
 SG_ Stack6_T11 m6 : 40|16@1- (0.0625,0) [-2048|2047.9375] "°C" Vector__XXX
 SG_ Stack7_T09 m7 : 8|16@1- (0.0625,0) [-2048|2047.9375] "°C" Vector__XXX
 SG_ Stack7_T10 m7 : 24|16@1- (0.0625,0) [-2048|2047.9375] "°C" Vector__XXX
 SG_ Stack7_T11 m7 : 40|16@1- (0.0625,0) [-2048|2047.9375] "°C" Vector__XXX
 SG_ StackID M : 0|8@1+ (1,0) [0|255] "" Vector__XXX

BO_ 2667577380 AMS_Temperature_4: 7 Third_Party
 SG_ Stack0_T12 m0 : 8|16@1- (0.0625,0) [-2048|2047.9375] "°C" Vector__XXX
 SG_ Stack0_T13 m0 : 24|16@1- (0.0625,0) [-2048|2047.9375] "°C" Vector__XXX
 SG_ Stack0_T14 m0 : 40|16@1- (0.0625,0) [-2048|2047.9375] "°C" Vector__XXX
 SG_ Stack1_T12 m1 : 8|16@1- (0.0625,0) [-2048|2047.9375] "°C" Vector__XXX
 SG_ Stack1_T13 m1 : 24|16@1- (0.0625,0) [-2048|2047.9375] "°C" Vector__XXX
 SG_ Stack1_T14 m1 : 40|16@1- (0.0625,0) [-2048|2047.9375] "°C" Vector__XXX
 SG_ Stack2_T12 m2 : 8|16@1- (0.0625,0) [-2048|2047.9375] "°C" Vector__XXX
 SG_ Stack2_T13 m2 : 24|16@1- (0.0625,0) [-2048|2047.9375] "°C" Vector__XXX
 SG_ Stack2_T14 m2 : 40|16@1- (0.0625,0) [-2048|2047.9375] "°C" Vector__XXX
 SG_ Stack3_T12 m3 : 8|16@1- (0.0625,0) [-2048|2047.9375] "°C" Vector__XXX
 SG_ Stack3_T13 m3 : 24|16@1- (0.0625,0) [-2048|2047.9375] "°C" Vector__XXX
 SG_ Stack3_T14 m3 : 40|16@1- (0.0625,0) [-2048|2047.9375] "°C" Vector__XXX
 SG_ Stack4_T12 m4 : 8|16@1- (0.0625,0) [-2048|2047.9375] "°C" Vector__XXX
 SG_ Stack4_T13 m4 : 24|16@1- (0.0625,0) [-2048|2047.9375] "°C" Vector__XXX
 SG_ Stack4_T14 m4 : 40|16@1- (0.0625,0) [-2048|2047.9375] "°C" Vector__XXX
 SG_ Stack5_T12 m5 : 8|16@1- (0.0625,0) [-2048|2047.9375] "°C" Vector__XXX
 SG_ Stack5_T13 m5 : 24|16@1- (0.0625,0) [-2048|2047.9375] "°C" Vector__XXX
 SG_ Stack5_T14 m5 : 40|16@1- (0.0625,0) [-2048|2047.9375] "°C" Vector__XXX
 SG_ Stack6_T12 m6 : 8|16@1- (0.0625,0) [-2048|2047.9375] "°C" Vector__XXX
 SG_ Stack6_T13 m6 : 24|16@1- (0.0625,0) [-2048|2047.9375] "°C" Vector__XXX
 SG_ Stack6_T14 m6 : 40|16@1- (0.0625,0) [-2048|2047.9375] "°C" Vector__XXX
 SG_ Stack7_T12 m7 : 8|16@1- (0.0625,0) [-2048|2047.9375] "°C" Vector__XXX
 SG_ Stack7_T13 m7 : 24|16@1- (0.0625,0) [-2048|2047.9375] "°C" Vector__XXX
 SG_ Stack7_T14 m7 : 40|16@1- (0.0625,0) [-2048|2047.9375] "°C" Vector__XXX
 SG_ StackID M : 0|8@1+ (1,0) [0|255] "" Vector__XXX

BO_ 2667577381 AMS_Temperature_5: 7 Third_Party
 SG_ Stack0_T15 m0 : 8|16@1- (0.0625,0) [-2048|2047.9375] "°C" Vector__XXX
 SG_ Stack0_T16 m0 : 24|16@1- (0.0625,0) [-2048|2047.9375] "°C" Vector__XXX
 SG_ Stack0_T17 m0 : 40|16@1- (0.0625,0) [-2048|2047.9375] "°C" Vector__XXX
 SG_ Stack1_T15 m1 : 8|16@1- (0.0625,0) [-2048|2047.9375] "°C" Vector__XXX
 SG_ Stack1_T16 m1 : 24|16@1- (0.0625,0) [-2048|2047.9375] "°C" Vector__XXX
 SG_ Stack1_T17 m1 : 40|16@1- (0.0625,0) [-2048|2047.9375] "°C" Vector__XXX
 SG_ Stack2_T15 m2 : 8|16@1- (0.0625,0) [-2048|2047.9375] "°C" Vector__XXX
 SG_ Stack2_T16 m2 : 24|16@1- (0.0625,0) [-2048|2047.9375] "°C" Vector__XXX
 SG_ Stack2_T17 m2 : 40|16@1- (0.0625,0) [-2048|2047.9375] "°C" Vector__XXX
 SG_ Stack3_T15 m3 : 8|16@1- (0.0625,0) [-2048|2047.9375] "°C" Vector__XXX
 SG_ Stack3_T16 m3 : 24|16@1- (0.0625,0) [-2048|2047.9375] "°C" Vector__XXX
 SG_ Stack3_T17 m3 : 40|16@1- (0.0625,0) [-2048|2047.9375] "°C" Vector__XXX
 SG_ Stack4_T15 m4 : 8|16@1- (0.0625,0) [-2048|2047.9375] "°C" Vector__XXX
 SG_ Stack4_T16 m4 : 24|16@1- (0.0625,0) [-2048|2047.9375] "°C" Vector__XXX
 SG_ Stack4_T17 m4 : 40|16@1- (0.0625,0) [-2048|2047.9375] "°C" Vector__XXX
 SG_ Stack5_T15 m5 : 8|16@1- (0.0625,0) [-2048|2047.9375] "°C" Vector__XXX
 SG_ Stack5_T16 m5 : 24|16@1- (0.0625,0) [-2048|2047.9375] "°C" Vector__XXX
 SG_ Stack5_T17 m5 : 40|16@1- (0.0625,0) [-2048|2047.9375] "°C" Vector__XXX
 SG_ Stack6_T15 m6 : 8|16@1- (0.0625,0) [-2048|2047.9375] "°C" Vector__XXX
 SG_ Stack6_T16 m6 : 24|16@1- (0.0625,0) [-2048|2047.9375] "°C" Vector__XXX
 SG_ Stack6_T17 m6 : 40|16@1- (0.0625,0) [-2048|2047.9375] "°C" Vector__XXX
 SG_ Stack7_T15 m7 : 8|16@1- (0.0625,0) [-2048|2047.9375] "°C" Vector__XXX
 SG_ Stack7_T16 m7 : 24|16@1- (0.0625,0) [-2048|2047.9375] "°C" Vector__XXX
 SG_ Stack7_T17 m7 : 40|16@1- (0.0625,0) [-2048|2047.9375] "°C" Vector__XXX
 SG_ StackID M : 0|8@1+ (1,0) [0|255] "" Vector__XXX

BO_ 2667577382 AMS_Temperature_6: 7 Third_Party
 SG_ Stack0_T18 m0 : 8|16@1- (0.0625,0) [-2048|2047.9375] "°C" Vector__XXX
 SG_ Stack0_T19 m0 : 24|16@1- (0.0625,0) [-2048|2047.9375] "°C" Vector__XXX
 SG_ Stack0_T20 m0 : 40|16@1- (0.0625,0) [-2048|2047.9375] "°C" Vector__XXX
 SG_ Stack1_T18 m1 : 8|16@1- (0.0625,0) [-2048|2047.9375] "°C" Vector__XXX
 SG_ Stack1_T19 m1 : 24|16@1- (0.0625,0) [-2048|2047.9375] "°C" Vector__XXX
 SG_ Stack1_T20 m1 : 40|16@1- (0.0625,0) [-2048|2047.9375] "°C" Vector__XXX
 SG_ Stack2_T18 m2 : 8|16@1- (0.0625,0) [-2048|2047.9375] "°C" Vector__XXX
 SG_ Stack2_T19 m2 : 24|16@1- (0.0625,0) [-2048|2047.9375] "°C" Vector__XXX
 SG_ Stack2_T20 m2 : 40|16@1- (0.0625,0) [-2048|2047.9375] "°C" Vector__XXX
 SG_ Stack3_T18 m3 : 8|16@1- (0.0625,0) [-2048|2047.9375] "°C" Vector__XXX
 SG_ Stack3_T19 m3 : 24|16@1- (0.0625,0) [-2048|2047.9375] "°C" Vector__XXX
 SG_ Stack3_T20 m3 : 40|16@1- (0.0625,0) [-2048|2047.9375] "°C" Vector__XXX
 SG_ Stack4_T18 m4 : 8|16@1- (0.0625,0) [-2048|2047.9375] "°C" Vector__XXX
 SG_ Stack4_T19 m4 : 24|16@1- (0.0625,0) [-2048|2047.9375] "°C" Vector__XXX
 SG_ Stack4_T20 m4 : 40|16@1- (0.0625,0) [-2048|2047.9375] "°C" Vector__XXX
 SG_ Stack5_T18 m5 : 8|16@1- (0.0625,0) [-2048|2047.9375] "°C" Vector__XXX
 SG_ Stack5_T19 m5 : 24|16@1- (0.0625,0) [-2048|2047.9375] "°C" Vector__XXX
 SG_ Stack5_T20 m5 : 40|16@1- (0.0625,0) [-2048|2047.9375] "°C" Vector__XXX
 SG_ Stack6_T18 m6 : 8|16@1- (0.0625,0) [-2048|2047.9375] "°C" Vector__XXX
 SG_ Stack6_T19 m6 : 24|16@1- (0.0625,0) [-2048|2047.9375] "°C" Vector__XXX
 SG_ Stack6_T20 m6 : 40|16@1- (0.0625,0) [-2048|2047.9375] "°C" Vector__XXX
 SG_ Stack7_T18 m7 : 8|16@1- (0.0625,0) [-2048|2047.9375] "°C" Vector__XXX
 SG_ Stack7_T19 m7 : 24|16@1- (0.0625,0) [-2048|2047.9375] "°C" Vector__XXX
 SG_ Stack7_T20 m7 : 40|16@1- (0.0625,0) [-2048|2047.9375] "°C" Vector__XXX
 SG_ StackID M : 0|8@1+ (1,0) [0|255] "" Vector__XXX

BO_ 2667577383 AMS_Temperature_7: 7 Third_Party
 SG_ Stack0_T21 m0 : 8|16@1- (0.0625,0) [-2048|2047.9375] "°C" Vector__XXX
 SG_ Stack0_T22 m0 : 24|16@1- (0.0625,0) [-2048|2047.9375] "°C" Vector__XXX
 SG_ Stack0_T23 m0 : 40|16@1- (0.0625,0) [-2048|2047.9375] "°C" Vector__XXX
 SG_ Stack1_T21 m1 : 8|16@1- (0.0625,0) [-2048|2047.9375] "°C" Vector__XXX
 SG_ Stack1_T22 m1 : 24|16@1- (0.0625,0) [-2048|2047.9375] "°C" Vector__XXX
 SG_ Stack1_T23 m1 : 40|16@1- (0.0625,0) [-2048|2047.9375] "°C" Vector__XXX
 SG_ Stack2_T21 m2 : 8|16@1- (0.0625,0) [-2048|2047.9375] "°C" Vector__XXX
 SG_ Stack2_T22 m2 : 24|16@1- (0.0625,0) [-2048|2047.9375] "°C" Vector__XXX
 SG_ Stack2_T23 m2 : 40|16@1- (0.0625,0) [-2048|2047.9375] "°C" Vector__XXX
 SG_ Stack3_T21 m3 : 8|16@1- (0.0625,0) [-2048|2047.9375] "°C" Vector__XXX
 SG_ Stack3_T22 m3 : 24|16@1- (0.0625,0) [-2048|2047.9375] "°C" Vector__XXX
 SG_ Stack3_T23 m3 : 40|16@1- (0.0625,0) [-2048|2047.9375] "°C" Vector__XXX
 SG_ Stack4_T21 m4 : 8|16@1- (0.0625,0) [-2048|2047.9375] "°C" Vector__XXX
 SG_ Stack4_T22 m4 : 24|16@1- (0.0625,0) [-2048|2047.9375] "°C" Vector__XXX
 SG_ Stack4_T23 m4 : 40|16@1- (0.0625,0) [-2048|2047.9375] "°C" Vector__XXX
 SG_ Stack5_T21 m5 : 8|16@1- (0.0625,0) [-2048|2047.9375] "°C" Vector__XXX
 SG_ Stack5_T22 m5 : 24|16@1- (0.0625,0) [-2048|2047.9375] "°C" Vector__XXX
 SG_ Stack5_T23 m5 : 40|16@1- (0.0625,0) [-2048|2047.9375] "°C" Vector__XXX
 SG_ Stack6_T21 m6 : 8|16@1- (0.0625,0) [-2048|2047.9375] "°C" Vector__XXX
 SG_ Stack6_T22 m6 : 24|16@1- (0.0625,0) [-2048|2047.9375] "°C" Vector__XXX
 SG_ Stack6_T23 m6 : 40|16@1- (0.0625,0) [-2048|2047.9375] "°C" Vector__XXX
 SG_ Stack7_T21 m7 : 8|16@1- (0.0625,0) [-2048|2047.9375] "°C" Vector__XXX
 SG_ Stack7_T22 m7 : 24|16@1- (0.0625,0) [-2048|2047.9375] "°C" Vector__XXX
 SG_ Stack7_T23 m7 : 40|16@1- (0.0625,0) [-2048|2047.9375] "°C" Vector__XXX
 SG_ StackID M : 0|8@1+ (1,0) [0|255] "" Vector__XXX

BO_ 2667577384 AMS_Temperature_8: 7 Third_Party
 SG_ Stack0_T24 m0 : 8|16@1- (0.0625,0) [-2048|2047.9375] "°C" Vector__XXX
 SG_ Stack0_T25 m0 : 24|16@1- (0.0625,0) [-2048|2047.9375] "°C" Vector__XXX
 SG_ Stack0_T26 m0 : 40|16@1- (0.0625,0) [-2048|2047.9375] "°C" Vector__XXX
 SG_ Stack1_T24 m1 : 8|16@1- (0.0625,0) [-2048|2047.9375] "°C" Vector__XXX
 SG_ Stack1_T25 m1 : 24|16@1- (0.0625,0) [-2048|2047.9375] "°C" Vector__XXX
 SG_ Stack1_T26 m1 : 40|16@1- (0.0625,0) [-2048|2047.9375] "°C" Vector__XXX
 SG_ Stack2_T24 m2 : 8|16@1- (0.0625,0) [-2048|2047.9375] "°C" Vector__XXX
 SG_ Stack2_T25 m2 : 24|16@1- (0.0625,0) [-2048|2047.9375] "°C" Vector__XXX
 SG_ Stack2_T26 m2 : 40|16@1- (0.0625,0) [-2048|2047.9375] "°C" Vector__XXX
 SG_ Stack3_T24 m3 : 8|16@1- (0.0625,0) [-2048|2047.9375] "°C" Vector__XXX
 SG_ Stack3_T25 m3 : 24|16@1- (0.0625,0) [-2048|2047.9375] "°C" Vector__XXX
 SG_ Stack3_T26 m3 : 40|16@1- (0.0625,0) [-2048|2047.9375] "°C" Vector__XXX
 SG_ Stack4_T24 m4 : 8|16@1- (0.0625,0) [-2048|2047.9375] "°C" Vector__XXX
 SG_ Stack4_T25 m4 : 24|16@1- (0.0625,0) [-2048|2047.9375] "°C" Vector__XXX
 SG_ Stack4_T26 m4 : 40|16@1- (0.0625,0) [-2048|2047.9375] "°C" Vector__XXX
 SG_ Stack5_T24 m5 : 8|16@1- (0.0625,0) [-2048|2047.9375] "°C" Vector__XXX
 SG_ Stack5_T25 m5 : 24|16@1- (0.0625,0) [-2048|2047.9375] "°C" Vector__XXX
 SG_ Stack5_T26 m5 : 40|16@1- (0.0625,0) [-2048|2047.9375] "°C" Vector__XXX
 SG_ Stack6_T24 m6 : 8|16@1- (0.0625,0) [-2048|2047.9375] "°C" Vector__XXX
 SG_ Stack6_T25 m6 : 24|16@1- (0.0625,0) [-2048|2047.9375] "°C" Vector__XXX
 SG_ Stack6_T26 m6 : 40|16@1- (0.0625,0) [-2048|2047.9375] "°C" Vector__XXX
 SG_ Stack7_T24 m7 : 8|16@1- (0.0625,0) [-2048|2047.9375] "°C" Vector__XXX
 SG_ Stack7_T25 m7 : 24|16@1- (0.0625,0) [-2048|2047.9375] "°C" Vector__XXX
 SG_ Stack7_T26 m7 : 40|16@1- (0.0625,0) [-2048|2047.9375] "°C" Vector__XXX
 SG_ StackID M : 0|8@1+ (1,0) [0|255] "" Vector__XXX

BO_ 2667577385 AMS_Temperature_9: 7 Third_Party
 SG_ Stack0_T27 m0 : 8|16@1- (0.0625,0) [-2048|2047.9375] "°C" Vector__XXX
 SG_ Stack1_T27 m1 : 8|16@1- (0.0625,0) [-2048|2047.9375] "°C" Vector__XXX
 SG_ Stack2_T27 m2 : 8|16@1- (0.0625,0) [-2048|2047.9375] "°C" Vector__XXX
 SG_ Stack3_T27 m3 : 8|16@1- (0.0625,0) [-2048|2047.9375] "°C" Vector__XXX
 SG_ Stack4_T27 m4 : 8|16@1- (0.0625,0) [-2048|2047.9375] "°C" Vector__XXX
 SG_ Stack5_T27 m5 : 8|16@1- (0.0625,0) [-2048|2047.9375] "°C" Vector__XXX
 SG_ Stack6_T27 m6 : 8|16@1- (0.0625,0) [-2048|2047.9375] "°C" Vector__XXX
 SG_ Stack7_T27 m7 : 8|16@1- (0.0625,0) [-2048|2047.9375] "°C" Vector__XXX
 SG_ StackID M : 0|8@1+ (1,0) [0|255] "" Vector__XXX

BA_DEF_  "DBName" STRING ;
BA_DEF_ BO_  "GenMsgCycleTime" INT 0 0;
BA_DEF_ BO_  "GenMsgSendType" ENUM  "Cyclic","OnEvent";
BA_DEF_ SG_  "GenSigStartValue" INT 0 0;
BA_DEF_ SG_  "SPN" INT 0 524287;
BA_DEF_DEF_  "DBName" "";
BA_DEF_DEF_  "GenMsgCycleTime" 0;
BA_DEF_DEF_  "GenMsgSendType" "";
BA_DEF_DEF_  "GenSigStartValue" 0;
BA_DEF_DEF_  "SPN" 0;
BA_ "DBName" "CAN6";
BA_ "GenMsgSendType" BO_ 0 0;
BA_ "GenMsgCycleTime" BO_ 0 100;
BA_ "GenMsgSendType" BO_ 2415919344 0;
BA_ "GenMsgCycleTime" BO_ 2415919344 100;
BA_ "GenMsgSendType" BO_ 2415919359 1;
BA_ "GenMsgSendType" BO_ 2667577360 0;
BA_ "GenMsgCycleTime" BO_ 2667577360 100;
BA_ "GenMsgSendType" BO_ 2667577361 0;
BA_ "GenMsgCycleTime" BO_ 2667577361 100;
BA_ "GenMsgSendType" BO_ 2667577362 0;
BA_ "GenMsgCycleTime" BO_ 2667577362 100;
BA_ "GenMsgSendType" BO_ 2667577363 0;
BA_ "GenMsgCycleTime" BO_ 2667577363 100;
BA_ "GenMsgSendType" BO_ 2667577364 0;
BA_ "GenMsgCycleTime" BO_ 2667577364 100;
BA_ "GenMsgSendType" BO_ 2667577365 0;
BA_ "GenMsgCycleTime" BO_ 2667577365 100;
BA_ "GenMsgSendType" BO_ 2667577376 0;
BA_ "GenMsgCycleTime" BO_ 2667577376 100;
BA_ "GenMsgSendType" BO_ 2667577377 0;
BA_ "GenMsgCycleTime" BO_ 2667577377 100;
BA_ "GenMsgSendType" BO_ 2667577378 0;
BA_ "GenMsgCycleTime" BO_ 2667577378 100;
BA_ "GenMsgSendType" BO_ 2667577379 0;
BA_ "GenMsgCycleTime" BO_ 2667577379 100;
BA_ "GenMsgSendType" BO_ 2667577380 0;
BA_ "GenMsgCycleTime" BO_ 2667577380 100;
BA_ "GenMsgSendType" BO_ 2667577381 0;
BA_ "GenMsgCycleTime" BO_ 2667577381 100;
BA_ "GenMsgSendType" BO_ 2667577382 0;
BA_ "GenMsgCycleTime" BO_ 2667577382 100;
BA_ "GenMsgSendType" BO_ 2667577383 0;
BA_ "GenMsgCycleTime" BO_ 2667577383 100;
BA_ "GenMsgSendType" BO_ 2667577384 0;
BA_ "GenMsgCycleTime" BO_ 2667577384 100;
BA_ "GenMsgSendType" BO_ 2667577385 0;
BA_ "GenMsgCycleTime" BO_ 2667577385 100;
